## firmware/sdkconfig.defaults
```kconfig
# PetFilter ESP32-S3 SDK Configuration
CONFIG_IDF_TARGET="esp32s3"

# Flash size (ESP32-S3-WROOM-1 = 8 MB)
CONFIG_ESPTOOLPY_FLASHSIZE_8MB=y

# Custom partition table (OTA A/B + certs partition)
CONFIG_PARTITION_TABLE_CUSTOM=y
CONFIG_PARTITION_TABLE_CUSTOM_FILENAME="partitions.csv"

# WiFi
CONFIG_ESP_WIFI_ENABLED=y
CONFIG_ESP_WIFI_MODE_STA=y

# Bluetooth Low Energy (Bluedroid — required by esp-idf-svc BLE GATT bindings)
# NimBLE uses less RAM but esp-idf-svc 0.51 wraps the Bluedroid GATT API.
CONFIG_BT_ENABLED=y
CONFIG_BT_BLUEDROID_ENABLED=y
CONFIG_BT_CLASSIC_ENABLED=n
CONFIG_BTDM_CTRL_MODE_BLE_ONLY=y
CONFIG_BT_BLE_42_FEATURES_SUPPORTED=y
CONFIG_BT_BLE_50_FEATURES_SUPPORTED=n
CONFIG_BT_BTC_TASK_STACK_SIZE=8192
CONFIG_BT_BLE_DYNAMIC_ENV_MEMORY=y

# ULP RISC-V Coprocessor (deep-sleep NH3 monitoring)
CONFIG_ULP_COPROC_ENABLED=y
CONFIG_ULP_COPROC_TYPE_RISCV=y
CONFIG_ULP_COPROC_RESERVE_MEM=4096

# Power management
CONFIG_PM_ENABLE=y

# NVS Encryption (HMAC-based key protection via eFuse block 0)
CONFIG_NVS_ENCRYPTION=y
CONFIG_NVS_SEC_KEY_PROTECT_USING_HMAC=y
CONFIG_NVS_SEC_HMAC_EFUSE_KEY_ID=0

# mbedTLS — TLS 1.3 + PSK cipher suites (RPC transport security)
CONFIG_MBEDTLS_SSL_PROTO_TLS1_3=y
CONFIG_MBEDTLS_SSL_TLS1_3_COMPATIBILITY_MODE=y
CONFIG_MBEDTLS_KEY_EXCHANGE_PSK=y
CONFIG_MBEDTLS_SSL_MAX_CONTENT_LEN=4096
CONFIG_MBEDTLS_HARDWARE_AES=y
CONFIG_MBEDTLS_HARDWARE_SHA=y

# mbedTLS — X.509 certificate support (Phase 3: cert-based mutual auth)
CONFIG_MBEDTLS_X509_CRT_PARSE_C=y
CONFIG_MBEDTLS_PEM_PARSE_C=y
CONFIG_MBEDTLS_KEY_EXCHANGE_ECDHE_RSA=y
CONFIG_MBEDTLS_KEY_EXCHANGE_ECDHE_ECDSA=y
CONFIG_MBEDTLS_ECP_C=y
CONFIG_MBEDTLS_ECDSA_C=y
CONFIG_MBEDTLS_ECP_DP_SECP256R1_ENABLED=y

# Watchdog (10s timeout — main loop must feed within this window)
CONFIG_ESP_TASK_WDT=y
CONFIG_ESP_TASK_WDT_TIMEOUT_S=10

# mDNS
CONFIG_MDNS_ENABLED=y

# Log level
CONFIG_LOG_DEFAULT_LEVEL_INFO=y

# ── Dual-core task pinning ──────────────────────────────────────
# Pin main() to Core 1 (APP_CPU) — dedicated to safety-critical control.
# Protocol stacks (WiFi, BLE, lwIP) remain on Core 0 (PRO_CPU).
CONFIG_FREERTOS_UNICORE=n
CONFIG_ESP_MAIN_TASK_AFFINITY=1
CONFIG_ESP_TIMER_TASK_AFFINITY=0

# Stack sizes — main task enlarged for complex control loop + TLS API calls
CONFIG_ESP_MAIN_TASK_STACK_SIZE=16384
CONFIG_PTHREAD_TASK_STACK_SIZE_DEFAULT=4096

# FreeRTOS runtime observability
CONFIG_FREERTOS_GENERATE_RUN_TIME_STATS=y
CONFIG_FREERTOS_USE_TRACE_FACILITY=y

# Stack overflow detection (hardware watchpoint at stack end)
CONFIG_FREERTOS_CHECK_STACKOVERFLOW_CANARY=y
CONFIG_FREERTOS_WATCHPOINT_END_OF_STACK=y

# ── Core dump to flash (crash diagnostics via RPC) ─────────────
CONFIG_ESP_COREDUMP_ENABLE_TO_FLASH=y
CONFIG_ESP_COREDUMP_DATA_FORMAT_ELF=y
CONFIG_ESP_COREDUMP_CHECKSUM_CRC32=y
CONFIG_ESP_COREDUMP_MAX_TASKS_NUM=16

# ── BLE security (bonding + encrypted link) ─────────────────────
CONFIG_BT_SMP_ENABLE=y
CONFIG_BT_BLE_SMP_ENABLE=y
CONFIG_BT_BLE_42_FEATURES_SUPPORTED=y
```
